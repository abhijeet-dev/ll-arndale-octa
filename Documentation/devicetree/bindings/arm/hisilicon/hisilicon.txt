## Documentation/devicetree/bindings/arm/hisilicon/hisilicon.txt
```
Hisilicon Platforms Device Tree Bindings
----------------------------------------------------

Hi4511 Board
Required root node properties:
	- compatible = "hisilicon,hi3620-hi4511";
HiP04 D01 Board
Required root node properties:
	- compatible = "hisilicon,hip04-d01";


Hisilicon system controller

Required properties:
- compatible : "hisilicon,sysctrl"
- reg : Register address and size

Optional properties:
- smp-offset : offset in sysctrl for notifying slave cpu booting
		cpu 1, reg;
		cpu 2, reg + 0x4;
		cpu 3, reg + 0x8;
		If reg value is not zero, cpun exit wfi and go
- resume-offset : offset in sysctrl for notifying cpu0 when resume
- reboot-offset : offset in sysctrl for system reboot
- relocation-entry : relocation address of secondary cpu boot code
- relocation-size : relocation size of secondary cpu boot code
- bootwrapper-phys : physical address of boot wrapper
- bootwrapper-size : size of boot wrapper
- bootwrapper-magic : magic number for secondary cpu in boot wrapper
The memory area of [bootwrapper-phys : bootwrapper-phys+bootwrapper-size]
should be reserved. This should be set in /memreserve/ node in DTS file.

Example:

	/* for Hi3620 */
	sysctrl: system-controller@fc802000 {
		compatible = "hisilicon,sysctrl";
		reg = <0xfc802000 0x1000>;
		smp-offset = <0x31c>;
		resume-offset = <0x308>;
		reboot-offset = <0x4>;
	};


PCTRL: Peripheral misc control register

Required Properties:
- compatible: "hisilicon,pctrl"
- reg: Address and size of pctrl.

Example:

	/* for Hi3620 */
	pctrl: pctrl@fca09000 {
		compatible = "hisilicon,pctrl";
		reg = <0xfca09000 0x1000>;
	};


Fabric:

Required Properties:
- compatible: "hisilicon,hip04-fabric";
- reg: Address and size of Fabric
```

## Documentation/devicetree/bindings/clock/hip04-clock.txt
```
* Hisilicon HiP04 Clock Controller

The HiP04 clock controller generates and supplies clock to various
controllers within the HiP04 SoC.

Required Properties:

- compatible: should be one of the following.
  - "hisilicon,hip04-clock" - controller compatible with HiP04 SoC.

- reg: physical base address of the controller and length of memory mapped
  region.

- #clock-cells: should be 1.


Each clock is assigned an identifier and client nodes use this identifier
to specify the clock which they consume.

All these identifier could be found in <dt-bindings/clock/hip04-clock.h>.
```
